/**
 * MIT License
 *
 * Copyright (c) 2021 Klatu Networks
 *
 * Permission is hereby granted, free of charge, to any person obtaining a copy
 * of this software and associated documentation files (the "Software"), to deal
 * in the Software without restriction, including without limitation the rights
 * to use, copy, modify, merge, publish, distribute, sublicense, and/or sell
 * copies of the Software, and to permit persons to whom the Software is
 * furnished to do so, subject to the following conditions:
 *
 * The above copyright notice and this permission notice shall be included in
 * all copies or substantial portions of the Software.
 *
 * THE SOFTWARE IS PROVIDED "AS IS", WITHOUT WARRANTY OF ANY KIND, EXPRESS OR
 * IMPLIED, INCLUDING BUT NOT LIMITED TO THE WARRANTIES OF MERCHANTABILITY,
 * FITNESS FOR A PARTICULAR PURPOSE AND NONINFRINGEMENT. IN NO EVENT SHALL THE
 * AUTHORS OR COPYRIGHT HOLDERS BE LIABLE FOR ANY CLAIM, DAMAGES OR OTHER
 * LIABILITY, WHETHER IN AN ACTION OF CONTRACT, TORT OR OTHERWISE, ARISING FROM,
 * OUT OF OR IN CONNECTION WITH THE SOFTWARE OR THE USE OR OTHER DEALINGS IN THE
 * SOFTWARE.
 */

// =============================================================================
// Includes

#include <stdio.h>
#include <stddef.h>


#include "FreeRTOS.h"
//#include "console.h"
//#include "hal_rtos.h"
#include "string.h"
#include "task.h"

//#include "winc_init.h"
#include "m2m_wifi.h"
#include "socket.h"
#include "nm_common.h"
#include "m2m_types.h"
#include "m2m_ssl.h"
//#include "programmer_apis.h"
//#include "root_tls_cert/root_setup.h"


#include "nw_winc.h"
#include "trace.h"

// =============================================================================
// Private types and definitions

#define NW_WINC_MGR_STACK_SIZE (1080/sizeof(portSTACK_TYPE))

#define NW_WINC_MGR_PRIORITY (tskIDLE_PRIORITY + 4)

#define NW_WINC_WIFI_CONNECTION_BIT           BIT0
#define NW_WINC_WIFI_DISCONNECTION_BIT        BIT1
#define NW_WINC_WIFI_SYS_TIME_BIT             BIT2
#define NW_WINC_WIFI_CUR_RSSI_BIT             BIT3
#define NW_WINC_WIFI_INIT_BIT                 BIT4
#define NW_WINC_WIFI_DEINIT_BIT               BIT5

#define NW_WINC_SOCKET_DNS_BIT                  BIT0
#define NW_WINC_SOCKET_CONNECTION_SUCCESS_BIT   BIT1
#define NW_WINC_SOCKET_CONNECTION_FAILURE_BIT   BIT2
#define NW_WINC_SOCKET_SEND_SUCCESS_BIT         BIT3
#define NW_WINC_SOCKET_SEND_FAILURE_BIT         BIT4
#define NW_WINC_SOCKET_RECV_SUCCESS_BIT         BIT5
#define NW_WINC_SOCKET_RECV_FAILURE_BIT         BIT6

// =============================================================================
// Private (forward) declarations
static void nw_winc_wifi_thread_entry(void *arg);

static void nw_winc_wifi_cb(uint8_t u8MsgType, void *pvMsg);

static void nw_winc_socket_cb(SOCKET sock, unsigned char u8Msg, void *pvMsg);

static void nw_winc_dns_resolve_cb(uint8_t *hostName, uint32_t addr);

static unsigned int nw_wifi_esp_start_tcp_client_connection(unsigned intsocket_index,uint32_t addr, unsigned int port,BOOLEAN is_ssl,int *socket_id);

static int  nw_wifi_esp_allot_socket_id();

// =============================================================================
// Private storage

static NW_WINC* pNwWifi;

const unsigned char certificate1_cer[] = {
0x2d,0x2d,0x2d,0x2d,0x2d,0x42,0x45,0x47,0x49,0x4e,0x20,0x43,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0x4f,
0x54,0x45,0x32,0x57,0x6a,0x42,0x6f,0x4d,0x51,0x73,0x77,0x43,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0x38,
0x4a,0x37,0x6f,0x58,0x2b,0x7a,0x6c,0x4a,0x30,0x54,0x31,0x4b,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0x50,
0x65,0x2f,0x57,0x39,0x33,0x62,0x43,0x36,0x6a,0x36,0x37,0x65,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0x63,
0x79,0x41,0x79,0x49,0x45,0x4e,0x6c,0x63,0x6e,0x52,0x70,0x5a,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0x4a,
0x6c,0x0d,0x0a,0x78,0x79,0x31,0x36,0x70,0x61,0x71,0x38,0x55,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0x0a,
};

const unsigned char certificate2_cer[] = {
0x2d,0x2d,0x2d,0x2d,0x2d,0x42,0x45,0x47,0x49,0x4e,0x20,0x43,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0x4e,
0x44,0x41,0x32,0x4d,0x6a,0x67,0x78,0x4e,0x7a,0x4d,0x35,0x4d,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0x41,
0x34,0x49,0x42,0x44,0x77,0x41,0x77,0x67,0x67,0x45,0x4b,0x41,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0x53,
0x58,0x78,0x6d,0x54,0x71,0x4d,0x36,0x62,0x61,0x6d,0x31,0x37,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0x45,
0x4d,0x49,0x4f,0x71,0x59,0x6a,0x6e,0x4d,0x45,0x38,0x47,0x43,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0x2f,
0x47,0x0d,0x0a,0x56,0x66,0x4b,0x79,0x42,0x44,0x62,0x74,0x67,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0x59,
0x63,0x53,0x4e,0x50,0x59,0x65,0x65,0x68,0x75,0x0d,0x0a,0x56,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0x0a,
};

const unsigned char certificate3_cer[] = {
0x2d,0x2d,0x2d,0x2d,0x2d,0x42,0x45,0x47,0x49,0x4e,0x20,0x43,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0x5a,
0x58,0x4a,0x32,0x61,0x57,0x4e,0x6c,0x63,0x79,0x42,0x53,0x62,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0x39,
0x31,0x67,0x68,0x59,0x50,0x6c,0x30,0x68,0x41,0x45,0x76,0x72,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0x79,
0x7a,0x69,0x4b,0x72,0x6c,0x41,0x34,0x62,0x39,0x76,0x37,0x4c,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0x49,
0x6d,0x68,0x30,0x64,0x48,0x41,0x36,0x4c,0x79,0x39,0x76,0x59,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0x73,
0x46,0x0d,0x0a,0x41,0x41,0x4f,0x43,0x41,0x51,0x45,0x41,0x59,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0x38,
0x35,0x68,0x64,0x4b,0x72,0x43,0x45,0x56,0x4e,0x0d,0x0a,0x30,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0x0a,
};

const unsigned char certificate4_cer[] = {
0x2d,0x2d,0x2d,0x2d,0x2d,0x42,0x45,0x47,0x49,0x4e,0x20,0x43,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0x42,
0x6b,0x46,0x74,0x59,0x58,0x70,0x76,0x62,0x6a,0x45,0x56,0x4d,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0x50,
0x6b,0x66,0x79,0x44,0x79,0x65,0x52,0x34,0x78,0x51,0x67,0x68,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0x41,
0x31,0x55,0x64,0x44,0x77,0x45,0x42,0x2f,0x77,0x51,0x45,0x41,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0x4c,
0x6d,0x4e,0x76,0x62,0x53,0x39,0x79,0x62,0x32,0x39,0x30,0x59,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0x35,
0x74,0x0d,0x0a,0x36,0x47,0x37,0x62,0x4d,0x51,0x63,0x54,0x38,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0x61,
0x72,0x32,0x70,0x52,0x2f,0x0d,0x0a,0x2d,0x2d,0x2d,0x2d,0x2d,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0x0a,
};


const unsigned char certificate5_cer[] = {
0x2d,0x2d,0x2d,0x2d,0x2d,0x42,0x45,0x47,0x49,0x4e,0x20,0x43,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0x64,
0x48,0x4a,0x68,0x65,0x48,0x68,0x6c,0x61,0x32,0x63,0x75,0x59,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0x2b,
0x53,0x35,0x49,0x68,0x7a,0x6e,0x49,0x6f,0x38,0x78,0x56,0x49,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0x35,
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0x63,0x55,0x61,0x6c,0x72,0x4f,0x70,0x37,0x67,0x4d,0x37,0x4d,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0x0a,
};


const unsigned char mycert2_pem[] = {
0x2d,0x2d,0x2d,0x2d,0x2d,0x42,0x45,0x47,0x49,0x4e,0x20,0x43,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0x64,
0x53,0x42,0x72,0x62,0x33,0x4e,0x31,0x63,0x6d,0x6b,0x78,0x49,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0x5a,
0x57,0x64,0x6e,0x65,0x54,0x45,0x55,0x4d,0x42,0x49,0x47,0x41,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0x76,
0x36,0x6d,0x39,0x38,0x57,0x50,0x77,0x74,0x65,0x53,0x58,0x48,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0x6b,
0x35,0x4c,0x4d,0x6f,0x71,0x79,0x67,0x5a,0x33,0x72,0x34,0x69,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0x0a,
};



// =============================================================================
// Public code

void NW_WINC_Init(NW_WINC*               pThis )
{  
	int i;

   // TRACE_DBG("%s() Entry(%x) \n", __FUNCTION__, M2M_WIFI_RESP_GET_SYS_TIME);
   // TRACE_DBG("%s() WINC PARAMETERS root cert addr =  %lu, root cert size = %lu \n", __FUNCTION__, M2M_TLS_ROOTCER_FLASH_OFFSET,M2M_TLS_ROOTCER_FLASH_SIZE);
    pNwWifi = pThis;

    memset((unsigned char*)pNwWifi,0x00,sizeof(NW_WINC));

    pNwWifi->wifi_event_group = xEventGroupCreate();

    for(i=0; i<NW_WINC_MAX_SOCKETS;i++)
    {
        pNwWifi->Sockets[i].event_group = xEventGroupCreate();
        pNwWifi->Sockets[i].socket_id = -1;
    }
#if 0
    /* Create Wifi  thread  used for scheduling call backs */
    OSA_ThreadCreate(&pNwWifi->h_wifi_thread,
                     NW_WINC_MGR_PRIORITY ,
                     nw_winc_wifi_thread_entry,
                     NULL,
                     "wifi_thread",
                     NULL,
                     NW_WINC_MGR_STACK_SIZE,
                     0);
#else
 // m2m_wifi_connect((char*)pNwWifi->ssid, strlen((char*)pNwWifi->ssid), pNwWifi->wifi_security, pNwWifi->pass_phrase, M2M_WIFI_CH_ALL);   
#endif 
}

void NW_WINC_Term()
{
    EventBits_t bits;
    TRACE_DBG("%s() Entry \n", __FUNCTION__);
#if 1
	m2m_wifi_disconnect();
 
    bits = xEventGroupWaitBits(pNwWifi->wifi_event_group,
                                   NW_WINC_WIFI_DISCONNECTION_BIT,
                                   pdFALSE,
                                   pdFALSE,
                                   portMAX_DELAY);
    if( ( bits & NW_WINC_WIFI_DISCONNECTION_BIT ) != 0 )
    {
        TRACE_INFO("%s() DISCONNECTED   \n", __FUNCTION__);
   
    }
 //   m2m_wifi_deinit(NULL);
//    nm_bsp_deinit();
#endif
#if 0
    WDRV_WINC_Deinitialize (sysObj.drvWifiWinc );


    bits = xEventGroupWaitBits(pNwWifi->wifi_event_group,
                                   NW_WINC_WIFI_DEINIT_BIT,
                                   pdFALSE,
                                   pdFALSE,
                                   portMAX_DELAY);
    if( ( bits & NW_WINC_WIFI_DEINIT_BIT ) != 0 )
    {
        TRACE_INFO("%s() DEINIT DONE  \n", __FUNCTION__);
   
    }
#endif
}

int NW_WINC_OpenSocket(NW_WINC_socket_type_t type,
                       unsigned char* ip_addr,
                       unsigned char* hostname, 
                       int port,
                       int* socket_id)
{
    unsigned int socket_array_index;
    int status = -1;
 	uint32_t addr = 0;

    TRACE_DBG("%s() Entry \n", __FUNCTION__);

    if(!pNwWifi->is_network_up)
    {
		TRACE_WARN("Waiting for Network Connection\n");
       	xEventGroupWaitBits(pNwWifi->wifi_event_group,
                                   NW_WINC_WIFI_CONNECTION_BIT,
                                   pdFALSE,
                                   pdFALSE,
                                   portMAX_DELAY);
    }
    TRACE_INFO("Network UP \n");
    socket_array_index = nw_wifi_esp_allot_socket_id();

    if(socket_array_index < 0)
    {
        TRACE_WARN("No Free socket array element available = %d\n", socket_array_index);
        return -1;
    }
    TRACE_DBG("Socket array element Allocated = %d \n", socket_array_index);
    
	if((hostname) && (!ip_addr))
	{
		strcpy((char*)pNwWifi->Sockets[socket_array_index].hostname,(char*)hostname);
		gethostbyname((uint8_t *)pNwWifi->Sockets[socket_array_index].hostname);
  		xEventGroupWaitBits(pNwWifi->Sockets[socket_array_index].event_group,
                                   NW_WINC_SOCKET_DNS_BIT,
                                   pdFALSE,
                                   pdFALSE,
                                   portMAX_DELAY);
		xEventGroupClearBits(pNwWifi->Sockets[socket_array_index].event_group,NW_WINC_SOCKET_DNS_BIT);
		if(pNwWifi->Sockets[socket_array_index].addr == 0x00)
		{
			TRACE_WARN("IP address not found for hostname = %s \n",pNwWifi->Sockets[socket_array_index].hostname);
			return -1;
		}			
		addr = pNwWifi->Sockets[socket_array_index].addr;
	}
	else if(ip_addr)
	{
        TRACE_DBG("IP ADDR given , Not Host name  = %s \n", ip_addr);
		addr = inet_addr((char*)ip_addr);
	}
    switch(type)
    {
        case NW_WIFI_TCP_CLIENT:
            status = nw_wifi_esp_start_tcp_client_connection(socket_array_index,addr, port,FALSE,socket_id);
            break;

        case NW_WIFI_SSL_TCP_CLIENT:
            status = nw_wifi_esp_start_tcp_client_connection(socket_array_index,addr, port,TRUE,socket_id);
            break;
		default:
			break;
    }
    if(!status)
    {
        *socket_id = socket_array_index;
        pNwWifi->Sockets[socket_array_index].is_socket_open = TRUE;
        pNwWifi->Sockets[socket_array_index].socket_type = type;
    }
    return (status == 1) ? 0 : -1;
}

int NW_WINC_CloseSocket(int socket_index)
{
    int status = -1;

    TRACE_DBG("%s() Entry \n", __FUNCTION__);

    switch(pNwWifi->Sockets[socket_index].socket_type)
    {
        case NW_WIFI_TCP_CLIENT:
            if(!close(pNwWifi->Sockets[socket_index].socket_id))
            {
                status = TRUE;
            }
            else
            {
                status = FALSE;
            }             
            break;

        case NW_WIFI_SSL_TCP_CLIENT:
            if(!close(pNwWifi->Sockets[socket_index].socket_id))
            {
               // SSL_shutdown(pNwWifi->Sockets[socket_index].ssl);
               // SSL_free(pNwWifi->Sockets[socket_index].ssl);
                status = TRUE;
            } 
            else
            {
                status = FALSE;
            }   
            break;
		default:
			break;
    }
    if(pNwWifi->Sockets[socket_index].is_socket_open)
    {
        pNwWifi->Sockets[socket_index].is_socket_open = FALSE;      
    }
    return (status == 1) ? 0 : -1;
}

int NW_WINC_SendSocket(int socket_index,unsigned char* buffer, int size)
{
    int status = -1;
    EventBits_t bits;
	
    TRACE_DBG("%s() Entry \n", __FUNCTION__);
    if(!pNwWifi->Sockets[socket_index].is_socket_open)
    {
        TRACE_WARN("Socket NOT open\n");
        return -1;
    }
    TRACE_DBG("%s  SEND Data  for Socket = %d \n",__FUNCTION__,pNwWifi->Sockets[socket_index].socket_id);
    switch(pNwWifi->Sockets[socket_index].socket_type)
    {
        case NW_WIFI_TCP_CLIENT:
            if(send(pNwWifi->Sockets[socket_index].socket_id, buffer, size, 0) > 0)
            {
                status = TRUE;
            }         
            else
            {
                status = FALSE;
            }                 
            break;
        case NW_WIFI_SSL_TCP_CLIENT:
        TRACE_DBG("%s()  NW_WIFI_SSL_TCP_CLIENT \n", __FUNCTION__);
            if(send(pNwWifi->Sockets[socket_index].socket_id, buffer, (unsigned short int)size, 0) > 0)
            {
                status = TRUE;
            } 
       
            else
            {
                status = FALSE;
            }                 
            break;

        default:
            break;
    }
    bits = xEventGroupWaitBits(pNwWifi->Sockets[socket_index].event_group,
                               NW_WINC_SOCKET_SEND_SUCCESS_BIT | NW_WINC_SOCKET_SEND_FAILURE_BIT,
                               pdFALSE,
                               pdFALSE,
                               portMAX_DELAY);

    xEventGroupClearBits(pNwWifi->Sockets[socket_index].event_group,NW_WINC_SOCKET_SEND_SUCCESS_BIT | NW_WINC_SOCKET_SEND_FAILURE_BIT);

    if( ( bits & NW_WINC_SOCKET_SEND_SUCCESS_BIT ) != 0 )
    {
        TRACE_INFO("%s() Data Sent SUCCESS \n", __FUNCTION__);
        status =  TRUE;
    }
    else if( ( bits & NW_WINC_SOCKET_SEND_FAILURE_BIT ) != 0 )
    {
        TRACE_WARN("%s() Data Sent  FAIL  \n", __FUNCTION__);
        status = FALSE;
    } 
    return (status == 1) ? 0 : -1;
}

int NW_WINC_ReceiveSocket(int socket_index, unsigned char* buffer, int size)
{
    switch(pNwWifi->Sockets[socket_index].socket_type)
    {
        case NW_WIFI_TCP_CLIENT:
        case NW_WIFI_SSL_TCP_CLIENT:
			pNwWifi->Sockets[socket_index].recv_buf = buffer;
			pNwWifi->Sockets[socket_index].recv_length = size;
			recv(pNwWifi->Sockets[socket_index].socket_id, buffer, size, 0); 
			xEventGroupWaitBits(pNwWifi->Sockets[socket_index].event_group,
                               NW_WINC_SOCKET_RECV_SUCCESS_BIT | NW_WINC_SOCKET_RECV_FAILURE_BIT,
                               pdFALSE,
                               pdFALSE,
                               portMAX_DELAY);

    		xEventGroupClearBits(pNwWifi->Sockets[socket_index].event_group,NW_WINC_SOCKET_RECV_SUCCESS_BIT | NW_WINC_SOCKET_RECV_FAILURE_BIT);
            break;
		default:
			break;
    }
    return size;

}

void NW_WINC_GetSysTime(unsigned char* time)
{
    TRACE_DBG("%s() Entry \n",__FUNCTION__);
    if(!pNwWifi->is_network_up)
    {
        TRACE_WARN("Waiting for Network Connection\n");
        xEventGroupWaitBits(pNwWifi->wifi_event_group,
                                   NW_WINC_WIFI_CONNECTION_BIT,
                                   pdFALSE,
                                   pdFALSE,
                                   portMAX_DELAY);
    }

    TRACE_INFO("Network UP = %p \n",pNwWifi->sys_time);
    m2m_wifi_get_system_time();

	xEventGroupClearBits(pNwWifi->wifi_event_group, NW_WINC_WIFI_SYS_TIME_BIT);
	/* wait for sys time */
    xEventGroupWaitBits(pNwWifi->wifi_event_group,
                        NW_WINC_WIFI_SYS_TIME_BIT,
                        pdFALSE,
                        pdFALSE,
                        portMAX_DELAY);
   strcpy((char*)time,(char*)pNwWifi->sys_time);
}

void NW_WINC_GetMacAddr(unsigned char* mac_addr)
{
	m2m_wifi_get_mac_address(mac_addr);
}

void NW_WINC_GetIpAddr(unsigned char* ip_addr)
{
	strcpy((char*)ip_addr,(char*)pNwWifi->ip_addr);
}


signed char NW_WINC_GetRssi()
{
    TRACE_DBG("%s() Entry \n",__FUNCTION__);

    m2m_wifi_req_curr_rssi();

    xEventGroupClearBits(pNwWifi->wifi_event_group, NW_WINC_WIFI_CUR_RSSI_BIT);
    /* wait for cur rssi  */
    xEventGroupWaitBits(pNwWifi->wifi_event_group,
                        NW_WINC_WIFI_CUR_RSSI_BIT,
                        pdFALSE,
                        pdFALSE,
                        portMAX_DELAY);
	TRACE_DBG("%s() Exit \n",__FUNCTION__);
    return pNwWifi->cur_rssi;
}
void NW_WINC_SignalInitComplete()
{
    TRACE_DBG("%s() Entry \n", __FUNCTION__);
	xEventGroupSetBits(pNwWifi->wifi_event_group, NW_WINC_WIFI_INIT_BIT);
}

void NW_WINC_wifi_cb_handler(uint8_t u8MsgType, void *pvMsg)
{
    nw_winc_wifi_cb( u8MsgType, pvMsg);
}

void NW_WINC_socket_init()
{
    socketInit();
    registerSocketCallback(nw_winc_socket_cb, nw_winc_dns_resolve_cb);

}
void NW_WINC_connect( unsigned char*         ssid,
                      unsigned char*         passphrase,
                      unsigned int           wifi_security)
{
    TRACE_DBG("%s() Entry \n",__FUNCTION__);

    strcpy((char*)pNwWifi->ssid, (char*)ssid);
    strcpy((char*)pNwWifi->pass_phrase, (char*)passphrase);
    pNwWifi->wifi_security = wifi_security;
 
    /* Wait for WLAN Initialisation */
    TRACE_DBG("%s() Waiting for WLAN Init Event \n",__FUNCTION__);
    
    xEventGroupWaitBits(pNwWifi->wifi_event_group,
                        NW_WINC_WIFI_INIT_BIT,
                        pdFALSE,
                        pdFALSE,
                        portMAX_DELAY);
   TRACE_DBG("%s()WLAN Init Event Received  \n",__FUNCTION__);



   TRACE_DBG("ssid ASKED = %s length = %d  \n",pNwWifi->ssid,strlen((char*)pNwWifi->ssid));
    m2m_wifi_connect((char*)pNwWifi->ssid, strlen((char*)pNwWifi->ssid), pNwWifi->wifi_security, pNwWifi->pass_phrase, M2M_WIFI_CH_ALL);   

}
void NW_WINC_DeInitComplete()
{			
	WDRV_WINC_CHIP_EN_Clear();
	WDRV_WINC_RESETN_Clear()  ;
    TRACE_DBG("%s() Entry \n", __FUNCTION__);
    xEventGroupSetBits(pNwWifi->wifi_event_group, NW_WINC_WIFI_DEINIT_BIT);
}
// =============================================================================
// Private (static) code
static  void nw_winc_wifi_cb(uint8_t u8MsgType, void *pvMsg)
{
    TRACE_DBG("%s() Entry = %x priority = %d \n",__FUNCTION__,u8MsgType,uxTaskPriorityGet(NULL));
    switch (u8MsgType)
    {
        case M2M_WIFI_RESP_CON_STATE_CHANGED:
        { 
            tstrM2mWifiStateChanged *pstrWifiState = (tstrM2mWifiStateChanged *)pvMsg;           
            if (pstrWifiState->u8CurrState == M2M_WIFI_CONNECTED) {
                TRACE_DBG("m2m_wifi_state: M2M_WIFI_RESP_CON_STATE_CHANGED: CONNECTED\n");
               // m2m_wifi_get_connection_info();
               // m2m_wifi_request_dhcp_client();
            }
            else if (pstrWifiState->u8CurrState == M2M_WIFI_DISCONNECTED) {
                TRACE_DBG("m2m_wifi_state: M2M_WIFI_RESP_CON_STATE_CHANGED: DISCONNECTED\n");
                m2m_wifi_connect((char*)pNwWifi->ssid, strlen((char*)pNwWifi->ssid), pNwWifi->wifi_security, pNwWifi->pass_phrase, M2M_WIFI_CH_ALL);
                pNwWifi->is_network_up = FALSE;
				WDRV_WINC_CHIP_EN_Clear();
				WDRV_WINC_RESETN_Clear()  ;
                xEventGroupSetBits(pNwWifi->wifi_event_group, NW_WINC_WIFI_DISCONNECTION_BIT);
                xEventGroupClearBits(pNwWifi->wifi_event_group, NW_WINC_WIFI_CONNECTION_BIT);
            }
        }
        break;

        case M2M_WIFI_REQ_DHCP_CONF:
        {
            uint8 *pu8IPAddress = (uint8 *)pvMsg;
            TRACE_DBG("m2m_wifi_state: M2M_WIFI_REQ_DHCP_CONF: IP is %u.%u.%u.%u\n",
                    pu8IPAddress[0],
                    pu8IPAddress[1],
                    pu8IPAddress[2],
                    pu8IPAddress[3]);
			sprintf((char*)pNwWifi->ip_addr,"%u.%u.%u.%u", pu8IPAddress[0],pu8IPAddress[1],pu8IPAddress[2],pu8IPAddress[3]);					
            pNwWifi->is_network_up = TRUE;
            xEventGroupSetBits(pNwWifi->wifi_event_group, NW_WINC_WIFI_CONNECTION_BIT);
            xEventGroupClearBits(pNwWifi->wifi_event_group, NW_WINC_WIFI_DISCONNECTION_BIT);
	
        }  
        break;

        case M2M_WIFI_RESP_GET_SYS_TIME:
        {
            tstrSystemTime *time = (tstrSystemTime *)pvMsg;
            TRACE_DBG("System Time \n");
            TRACE_DBG("%u/%u/%u %u:%u:%u\n",
                      time->u8Day,
                      time->u8Month,
                      time->u16Year,
                      time->u8Hour,
                      time->u8Minute,
                      time->u8Second);
			if(time->u16Year == 0x00)
			{
				TRACE_WARN("SNTP Synch is yet to happen\n");
				break;			
			}

#if 1
			sprintf((char*)pNwWifi->sys_time,"%d/%d/%d %d:%d:%d",time->u8Day,time->u8Month,time->u16Year,time->u8Hour,time->u8Minute,time->u8Second);
#endif
			xEventGroupSetBits(pNwWifi->wifi_event_group, NW_WINC_WIFI_SYS_TIME_BIT);
        }  
        break;

        case M2M_WIFI_RESP_CURRENT_RSSI :
            pNwWifi->cur_rssi = *((signed char*)pvMsg);
            TRACE_DBG("pNwWifi->cur_rssi = %d \n",pNwWifi->cur_rssi);
            xEventGroupSetBits(pNwWifi->wifi_event_group, NW_WINC_WIFI_CUR_RSSI_BIT);
        break; 

        default:
            break;
    }
}

static void nw_winc_socket_cb(SOCKET sock, uint8 u8Msg, void *pvMsg)
{

    int i;

	TRACE_DBG("%s() Entry(sock = %d)  Msg = %x\n", __FUNCTION__,sock,u8Msg);

    for(i=0; i<NW_WINC_MAX_SOCKETS;i++)
    {  
		if(pNwWifi->Sockets[i].socket_id == sock)
        {
            break;
        }        
    }
    //TRACE_DBG("%s() Socket Array Element Found  = %d\n", __FUNCTION__,i);
    switch (u8Msg) 
    {
        /* Socket connected */

        case SOCKET_MSG_CONNECT:
        {
            tstrSocketConnectMsg *pstrConnect = (tstrSocketConnectMsg *)pvMsg;
            if (pstrConnect->s8Error == 0) 
            {
                TRACE_DBG("%s Socket = %d Connected OK \n",__FUNCTION__,sock);
				xEventGroupSetBits(pNwWifi->Sockets[i].event_group, NW_WINC_SOCKET_CONNECTION_SUCCESS_BIT);
            }
            else
            {
                TRACE_DBG("%s Socket Connected ERROR = %d \n",__FUNCTION__,pstrConnect->s8Error);
				xEventGroupSetBits(pNwWifi->Sockets[i].event_group, NW_WINC_SOCKET_CONNECTION_FAILURE_BIT);
            }
        }
            break; 

        /* Message send */
        case SOCKET_MSG_SEND: 
            TRACE_DBG("%s Data SEND OK for sock = %d \n",__FUNCTION__,sock);
            xEventGroupSetBits(pNwWifi->Sockets[i].event_group, NW_WINC_SOCKET_SEND_SUCCESS_BIT);
            break;

        /* Message receive */
        case SOCKET_MSG_RECV: 
        {
            tstrSocketRecvMsg *pstrRecv = (tstrSocketRecvMsg *)pvMsg;
            if (pstrRecv && pstrRecv->s16BufferSize > 0)
            {
                TRACE_DBG("%s Data RECV OK for sock = %d   pstrRecv->u16RemainingSize = %d \n",__FUNCTION__,sock, pstrRecv->u16RemainingSize);
				if( pstrRecv->u16RemainingSize == 0x00)
            	{   
                	memcpy(&pNwWifi->Sockets[i].recv_buf[pNwWifi->Sockets[i].prev_recv_length],pstrRecv->pu8Buffer,pstrRecv->s16BufferSize);
					pNwWifi->Sockets[i].prev_recv_length = 0x00;
					xEventGroupSetBits(pNwWifi->Sockets[i].event_group, NW_WINC_SOCKET_RECV_SUCCESS_BIT);
				}
				else
				{
                	memcpy(&pNwWifi->Sockets[i].recv_buf[pNwWifi->Sockets[i].prev_recv_length],pstrRecv->pu8Buffer,pstrRecv->s16BufferSize);
					pNwWifi->Sockets[i].prev_recv_length +=pstrRecv->s16BufferSize;
				}
            }
            else
            {
                TRACE_WARN("%s Recv ERROR \n",__FUNCTION__);
                xEventGroupSetBits(pNwWifi->Sockets[i].event_group, NW_WINC_SOCKET_RECV_FAILURE_BIT);
            }
        } 
            break;

        default:  
            break;
    }
}

static void nw_winc_dns_resolve_cb(uint8_t *hostname, uint32_t addr)
{
	unsigned int i;
	TRACE_DBG("%s() Entry  \n", __FUNCTION__);

    for(i=0; i<NW_WINC_MAX_SOCKETS;i++)
    {  
		if(!strcmp((char*)pNwWifi->Sockets[i].hostname,(char*)hostname))
        {
            break;
        }        
    }
    TRACE_DBG("%s() Socket Array Element Found  = %d\n", __FUNCTION__,i);
    if(addr)
    {
        TRACE_DBG("%s() DNS Resolved  = %lu\n", __FUNCTION__,addr);

	    pNwWifi->Sockets[i].addr = addr;

	    xEventGroupSetBits(pNwWifi->Sockets[i].event_group, NW_WINC_SOCKET_DNS_BIT);
    }
}
//extern uint8_t gau8CertMem[M2M_TLS_SERVER_FLASH_SIZE];
static unsigned int nw_wifi_esp_start_tcp_client_connection(unsigned int socket_index,uint32_t addr, unsigned int port, BOOLEAN is_ssl,int *socket_id) 
{
    unsigned int status = FALSE;
    struct sockaddr_in dest_addr;
    EventBits_t bits;
	int					ret = -1;
   
    TRACE_DBG("%s() Entry \n",__FUNCTION__);

    memset(&dest_addr, 0, sizeof(dest_addr));
      
    dest_addr.sin_addr.s_addr = addr;
    dest_addr.sin_family = AF_INET;
    dest_addr.sin_port = _htons(port);
    if(is_ssl)
    {
        TRACE_DBG("%s() SSL Socket Id Creation222222 \n",__FUNCTION__);
#if 0
	    m2m_wifi_deinit(NULL);
		int8_t ret = m2m_wifi_download_mode();
		if (ret != M2M_SUCCESS) {
			printf("Unable to enter download mode\n");
		}
		else
		{
			printf("ENTERED DOWNLOAD MODE\n");
		}
			//	programmer_read_root_cert(gau8CertMem);

		#if 0
		ret = programmer_erase_root_cert();

			if(M2M_SUCCESS != ret)
			{ 
				printf("ERASE FAILED , NOT ABLE TO UPDATE certificates \n");
					return -1 ;
			}
		#endif
		WriteRootCertificate(mycert2_pem,sizeof(mycert2_pem));	
		WriteRootCertificate(certificate1_cer,sizeof(certificate1_cer));
		WriteRootCertificate(certificate2_cer,sizeof(certificate2_cer));
		WriteRootCertificate(certificate3_cer,sizeof(certificate3_cer));	
		WriteRootCertificate(certificate4_cer,sizeof(certificate4_cer));
		WriteRootCertificate(certificate5_cer,sizeof(certificate5_cer));
		printf("Writing Certificate completed\n");
					read_check_certificates();
		while(1);
#else		
        *socket_id =  socket(AF_INET, SOCK_STREAM, SOCKET_FLAGS_SSL);  
#endif  
    }
    else
    {
        *socket_id =  socket(AF_INET, SOCK_STREAM, 0);        
    }
    if(*socket_id != -1)
    { 


		int flag_val = 1U;
        setsockopt(*socket_id, SOL_SSL_SOCKET, SO_SSL_BYPASS_X509_VERIF, (int*)&flag_val, 1U);
        pNwWifi->Sockets[socket_index].socket_id = *socket_id;

        TRACE_DBG("Socket(%d) created, connecting \n",*socket_id);

        if(connect(*socket_id, (struct sockaddr *)&dest_addr, sizeof(struct sockaddr_in)) < 0)
        {
            TRACE_DBG("Socket unable to connect\n");
            status =  FALSE;
        }
        else
        {
           TRACE_DBG("Waiting for Connection = %d \n",socket_index);
            /* wait for Connect Event */
            bits = xEventGroupWaitBits(pNwWifi->Sockets[socket_index].event_group,
                               NW_WINC_SOCKET_CONNECTION_SUCCESS_BIT | NW_WINC_SOCKET_CONNECTION_FAILURE_BIT,
                               pdFALSE,
                               pdFALSE,
                               portMAX_DELAY);

            xEventGroupClearBits(pNwWifi->Sockets[socket_index].event_group,NW_WINC_SOCKET_CONNECTION_SUCCESS_BIT | NW_WINC_SOCKET_CONNECTION_FAILURE_BIT);

            //TRACE_DBG("BITS  = %x\n",bits);
            if( ( bits & NW_WINC_SOCKET_CONNECTION_SUCCESS_BIT ) != 0 )
            {
                TRACE_INFO("%s() Socket Connect SUCCESS \n", __FUNCTION__);
                status =  TRUE;
            }
            else if( ( bits & NW_WINC_SOCKET_CONNECTION_FAILURE_BIT ) != 0 )
            {
                TRACE_WARN("%s() Socket Connect  FAIL  \n", __FUNCTION__);
                status = FALSE;
            }
        }
    }
    else
    {
        status = FALSE;
    }
    return (status == 1) ? 0 : -1;
}

static int  nw_wifi_esp_allot_socket_id()
{
    int socket_id = -1;
    unsigned int i;

    for(i=0; i < NW_WINC_MAX_SOCKETS; i++)
    {
        if(!pNwWifi->Sockets[i].is_socket_open)
        {
            socket_id = i;
            break;
        } 
    }
    return socket_id;
}












































































































































































